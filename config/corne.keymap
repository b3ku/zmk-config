/*
 * Copyright (c) 2020 The ZMK Contributors
 *
 * SPDX-License-Identifier: MIT
 */

#include <behaviors.dtsi>
#include <dt-bindings/zmk/keys.h>
#include <dt-bindings/zmk/bt.h>

#include "config.dtsi"

/ {
    #include "behaviors.dtsi"
    #include "macros.dtsi"
    #include "combos.dtsi"

    keymap {
        compatible = "zmk,keymap";

        #include "layer_default.dtsi"
        #include "layer_fn.dtsi"
        #include "layer_num.dtsi"
    };
};
