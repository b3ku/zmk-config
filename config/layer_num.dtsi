/*
    ╭───────────────────────╮ ╭───────────────────╮
    │                       │ │  1  2  3   +   -  │
    │ CTRL ALT CMD SHIFT    │ │  4  5  6   (   )  │
    │                       │ │  7  8  9  *^  /%  │
    ╰─────────╮             │ │ 0=  <  > ╭────────╯
              ╰─────────────╯ ╰──────────╯
*/

num_layer {
    bindings = <
        &trans  &trans  &trans  &trans  &trans  &trans         &kp KP_N1    &kp KP_N2   &kp KP_N2   &kp KP_PLUS     &kp KP_MINUS    &trans
        &trans  &trans  &trans  &trans  &trans  &trans         &kp KP_N4    &kp KP_N5   &kp KP_N6   &td_LBRACKETS   &td_RBRACKETS   &trans
        &trans  &trans  &trans  &trans  &trans  &trans         &kp KP_N7    &kp KP_N8   &kp KP_N9   &mm_MULTIPLY    &mm_DIVIDE      &trans
                                &trans  &trans  &trans         &kp N0   &kp LESS_THAN   &kp GREATER_THAN
    >;
};